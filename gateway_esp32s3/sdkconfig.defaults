## gateway_esp32s3/sdkconfig.defaults
```kconfig
# ESP32-S3 Bluetooth Mesh Gateway Configuration
CONFIG_BT_ENABLED=y
CONFIG_BT_BLUEDROID_ENABLED=y
CONFIG_BT_BLE_42_FEATURES_SUPPORTED=y
CONFIG_BT_BTU_TASK_STACK_SIZE=4512
CONFIG_BT_GATTS_SEND_SERVICE_CHANGE_MANUAL=y
CONFIG_PARTITION_TABLE_SINGLE_APP_LARGE=y

CONFIG_BLE_MESH=y
CONFIG_BLE_MESH_NODE=y
CONFIG_BLE_MESH_PB_ADV=y
CONFIG_BLE_MESH_PB_GATT=y
CONFIG_BLE_MESH_GATT_PROXY_SERVER=y
CONFIG_BLE_MESH_CFG_SRV=y
CONFIG_BLE_MESH_HEALTH_SRV=y
CONFIG_BLE_MESH_SENSOR_CLI=y
CONFIG_BLE_MESH_GENERIC_SERVER=y
CONFIG_BLE_MESH_RELAY=y
CONFIG_BLE_MESH_FRIEND=y
CONFIG_BLE_MESH_TX_SEG_MSG_COUNT=10
CONFIG_BLE_MESH_RX_SEG_MSG_COUNT=10

# Disable Brownout Detector in ESP-IDF v5.x
CONFIG_ESP_SYSTEM_BROWNOUT_DET=n
CONFIG_ESP_BROWNOUT_DET=n

# Reduce system log level to WARN to hide noisy internal stack logs
CONFIG_LOG_DEFAULT_LEVEL_WARN=y
CONFIG_LOG_DEFAULT_LEVEL=2
```
